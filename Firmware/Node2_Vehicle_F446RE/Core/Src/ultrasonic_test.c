/**
 * @file  ultrasonic_test.c
 * @brief M1 ⑤ HC-SR04 Input Capture standalone test (bare metal)
 *
 * Wiring:
 *   PC7 (D9)  -> HC-SR04 TRIG
 *   PB6 (D10) <- HC-SR04 ECHO through a 1 kohm / 2 kohm divider
 *
 * TIM4 runs at 1 MHz, so one captured timer count equals one microsecond.
 */

#include "main.h"
#include "ultrasonic_test.h"

#include <stdio.h>

#define ULTRASONIC_PERIOD_MS       60U
#define ULTRASONIC_TIMEOUT_MS      30U
#define ULTRASONIC_MIN_PULSE_US   116U  /* approximately 2 cm */
#define ULTRASONIC_MAX_PULSE_US 23200U  /* approximately 4 m  */
#define TIM4_COUNTER_COUNTS     65536U

typedef enum {
    CAPTURE_IDLE = 0,
    CAPTURE_WAIT_RISING,
    CAPTURE_WAIT_FALLING,
    CAPTURE_READY
} capture_state_t;

static TIM_HandleTypeDef *s_htim;
static volatile capture_state_t s_state = CAPTURE_IDLE;
static volatile uint32_t s_rising_count;
static volatile uint32_t s_pulse_us;
static uint32_t s_started_ms;
static uint32_t s_next_trigger_ms;
static uint32_t s_sample_count;
static uint32_t s_timeout_count;

static void delay_us(uint32_t us)
{
    const uint32_t cycles_per_us = HAL_RCC_GetHCLKFreq() / 1000000U;
    const uint32_t start = DWT->CYCCNT;
    const uint32_t wait_cycles = cycles_per_us * us;

    while ((uint32_t)(DWT->CYCCNT - start) < wait_cycles) {
        /* Only the fixed 10 us TRIG pulse is generated by this short wait. */
    }
}

static void start_measurement(uint32_t now_ms)
{
    __HAL_TIM_DISABLE_IT(s_htim, TIM_IT_CC1);
    __HAL_TIM_SET_CAPTUREPOLARITY(s_htim, TIM_CHANNEL_1,
                                  TIM_INPUTCHANNELPOLARITY_RISING);
    __HAL_TIM_SET_COUNTER(s_htim, 0U);
    __HAL_TIM_CLEAR_FLAG(s_htim, TIM_FLAG_CC1);

    s_state = CAPTURE_WAIT_RISING;
    s_started_ms = now_ms;
    __HAL_TIM_ENABLE_IT(s_htim, TIM_IT_CC1);

    HAL_GPIO_WritePin(US_TRIG_GPIO_Port, US_TRIG_Pin, GPIO_PIN_SET);
    delay_us(10U);
    HAL_GPIO_WritePin(US_TRIG_GPIO_Port, US_TRIG_Pin, GPIO_PIN_RESET);
}

void UltrasonicTest_Init(TIM_HandleTypeDef *htim)
{
    s_htim = htim;
    s_state = CAPTURE_IDLE;
    s_sample_count = 0U;
    s_timeout_count = 0U;
    s_next_trigger_ms = HAL_GetTick();

    HAL_GPIO_WritePin(US_TRIG_GPIO_Port, US_TRIG_Pin, GPIO_PIN_RESET);

    /* DWT gives an accurate 10 us pulse without consuming another timer. */
    CoreDebug->DEMCR |= CoreDebug_DEMCR_TRCENA_Msk;
    DWT->CYCCNT = 0U;
    DWT->CTRL |= DWT_CTRL_CYCCNTENA_Msk;

    if (HAL_TIM_IC_Start(s_htim, TIM_CHANNEL_1) != HAL_OK) {
        Error_Handler();
    }
    __HAL_TIM_DISABLE_IT(s_htim, TIM_IT_CC1);

    printf("\r\n");
    printf("===========================================\r\n");
    printf(" M1-5 HC-SR04 TIM4 Input Capture Test\r\n");
    printf("===========================================\r\n");
    printf(" SYSCLK : %lu Hz\r\n", (unsigned long)HAL_RCC_GetSysClockFreq());
    printf(" PCLK1  : %lu Hz (TIM4 clock = x2)\r\n",
           (unsigned long)HAL_RCC_GetPCLK1Freq());
    printf(" TIM4   : PSC=%lu ARR=%lu -> 1 count/us\r\n",
           (unsigned long)s_htim->Init.Prescaler,
           (unsigned long)s_htim->Init.Period);
    printf(" Period : %lu ms, timeout: %lu ms\r\n",
           (unsigned long)ULTRASONIC_PERIOD_MS,
           (unsigned long)ULTRASONIC_TIMEOUT_MS);
    printf(" Place a flat target at 10/20/50/100 cm.\r\n");
    printf(" PASS criterion: absolute error <= 2 cm.\r\n");
    printf("-------------------------------------------\r\n");
}

void UltrasonicTest_Process(void)
{
    const uint32_t now_ms = HAL_GetTick();

    if (s_state == CAPTURE_READY) {
        const uint32_t pulse_us = s_pulse_us;
        const uint32_t distance_mm = (pulse_us * 343U + 1000U) / 2000U;

        s_state = CAPTURE_IDLE;
        ++s_sample_count;

        if ((pulse_us < ULTRASONIC_MIN_PULSE_US) ||
            (pulse_us > ULTRASONIC_MAX_PULSE_US)) {
            printf("[%5lu] OUT_OF_RANGE pulse=%lu us distance=%lu.%lu cm\r\n",
                   (unsigned long)s_sample_count,
                   (unsigned long)pulse_us,
                   (unsigned long)(distance_mm / 10U),
                   (unsigned long)(distance_mm % 10U));
        } else {
            printf("[%5lu] OK pulse=%lu us distance=%lu.%lu cm\r\n",
                   (unsigned long)s_sample_count,
                   (unsigned long)pulse_us,
                   (unsigned long)(distance_mm / 10U),
                   (unsigned long)(distance_mm % 10U));
            HAL_GPIO_TogglePin(LD2_GPIO_Port, LD2_Pin);
        }
    }

    if (((s_state == CAPTURE_WAIT_RISING) ||
         (s_state == CAPTURE_WAIT_FALLING)) &&
        ((uint32_t)(now_ms - s_started_ms) >= ULTRASONIC_TIMEOUT_MS)) {
        __HAL_TIM_DISABLE_IT(s_htim, TIM_IT_CC1);
        __HAL_TIM_SET_CAPTUREPOLARITY(s_htim, TIM_CHANNEL_1,
                                      TIM_INPUTCHANNELPOLARITY_RISING);
        s_state = CAPTURE_IDLE;
        ++s_timeout_count;
        printf("[TIMEOUT %lu] No ECHO within %lu ms - check 5V/GND/divider\r\n",
               (unsigned long)s_timeout_count,
               (unsigned long)ULTRASONIC_TIMEOUT_MS);
    }

    if ((s_state == CAPTURE_IDLE) &&
        ((int32_t)(now_ms - s_next_trigger_ms) >= 0)) {
        start_measurement(now_ms);
        s_next_trigger_ms = now_ms + ULTRASONIC_PERIOD_MS;
    }
}

void HAL_TIM_IC_CaptureCallback(TIM_HandleTypeDef *htim)
{
    uint32_t captured;

    if ((htim != s_htim) ||
        (htim->Channel != HAL_TIM_ACTIVE_CHANNEL_1)) {
        return;
    }

    captured = HAL_TIM_ReadCapturedValue(htim, TIM_CHANNEL_1);

    if (s_state == CAPTURE_WAIT_RISING) {
        s_rising_count = captured;
        __HAL_TIM_SET_CAPTUREPOLARITY(htim, TIM_CHANNEL_1,
                                      TIM_INPUTCHANNELPOLARITY_FALLING);
        s_state = CAPTURE_WAIT_FALLING;
    } else if (s_state == CAPTURE_WAIT_FALLING) {
        if (captured >= s_rising_count) {
            s_pulse_us = captured - s_rising_count;
        } else {
            s_pulse_us = TIM4_COUNTER_COUNTS - s_rising_count + captured;
        }

        __HAL_TIM_DISABLE_IT(htim, TIM_IT_CC1);
        __HAL_TIM_SET_CAPTUREPOLARITY(htim, TIM_CHANNEL_1,
                                      TIM_INPUTCHANNELPOLARITY_RISING);
        s_state = CAPTURE_READY;
    }
}
